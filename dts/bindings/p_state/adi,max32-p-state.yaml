## dts/bindings/p_state/adi,max32-p-state.yaml
```yaml
# Copyright (c) 2025 Analog Devices, Inc.
#
# SPDX-License-Identifier: Apache-2.0

description: Max32 custom properties for performance state (p-state)

compatible: "adi,max32-p-state"

include: "zephyr,p-state.yaml"

properties:
  p-state-id:
    type: int
    required: true
    description: |
      Identifier of performance state which maps to a divider setting.
```

## subsys/cpu_freq/Kconfig
```kconfig
# Copyright (c) 2025 Analog Devices, Inc.
#
# SPDX-License-Identifier: Apache-2.0

menuconfig CPU_FREQ
	bool "CPU Frequency Scaling Subsystem"
	select THREAD_RUNTIME_STATS
	select SCHED_THREAD_USAGE
	select SCHED_THREAD_USAGE_ALL
	select SCHED_THREAD_USAGE_AUTO_ENABLE
	depends on !SMP
	help
	  CPU Frequency scaling subsystem

if CPU_FREQ

module = CPU_FREQ
module-str = CPU Frequency Scaling
source "subsys/logging/Kconfig.template.log_config"

config CPU_FREQ_INTERVAL_MS
	int "CPU Freq evaluation interval"
	default 1000
	help
	  Controls the interval (in milliseconds) at which the CPU Frequency
	  subsystem runs and evaluates the current policy.

choice CPU_FREQ_POLICY
	prompt "CPU Frequency Scaling Policy"
	default CPU_FREQ_POLICY_NONE
	help
	  The policy algorithm to use when using the CPU freq subsystem.

config CPU_FREQ_POLICY_NONE
	bool "No selected policy"
	help
	  Kconfig placeholder if no policy is chosen. This Kconfig will produce a build error

config CPU_FREQ_POLICY_ON_DEMAND
	bool "On-demand Policy"

endchoice # CPU_FREQ_POLICY

endif # CPU_FREQ
```
