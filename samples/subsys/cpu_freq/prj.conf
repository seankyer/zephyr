## prj.conf
```kconfig
# Copyright (c) 2025 Analog Devices, Inc.
#
# SPDX-License-Identifier: Apache-2.0

CONFIG_LOG=y

# CPU Frequency Subsystem Configuration
CONFIG_CPU_FREQ=y
CONFIG_CPU_FREQ_LOG_LEVEL_DBG=y
CONFIG_CPU_FREQ_INTERVAL_MS=4000
CONFIG_CPU_FREQ_POLICY_ON_DEMAND=y
```

## boards/max32655fthr_max32655_m4.overlay
```dts
/*
 * Copyright (c) 2025 Analog Devices, Inc.
 *
 * SPDX-License-Identifier: Apache-2.0
 */

/* Example devicetree definition of performance-states */

/ {
	performance-states {
		p_state_0: p_state_0 {
			compatible = "adi,max32-p-state";
			load-threshold = <50>;
			p-state-id = <0>;
		};
		p_state_1: p_state_1 {
			compatible = "adi,max32-p-state";
			load-threshold = <0>;
			p-state-id = <1>;
		};
	};
};
```

## src/main.c
```c
/*
 * Copyright (c) 2025 Analog Devices, Inc.
 *
 * SPDX-License-Identifier: Apache-2.0
 */

#include <stdio.h>
#include <zephyr/kernel.h>
#include <zephyr/logging/log.h>

LOG_MODULE_REGISTER(cpu_freq_sample, LOG_LEVEL_INF);

int main(void)
{
	LOG_INF("Starting CPU Freq Subsystem Sample!\n");

	while (1) {
		/* Some busy work... */
		k_sleep(K_SECONDS(1));
	}
}
```
